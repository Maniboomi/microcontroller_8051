ORG 0000H

MOV P2, #00H
MOV P3, #00H

MAIN:
	CALL INIT_LCD
	MOV DPTR , #MSG
	CALL DISPLAY
	
HERE:
	SJMP HERE
	
INIT_LCD:
	MOV A, #38H
	ACALL LCD_CMD
	MOV A, #0EH
	ACALL LCD_CMD
	MOV A, #01H
	ACALL LCD_CMD
	MOV A, #06H
	ACALL LCD_CMD
	MOV A, #80H	
	ACALL LCD_CMD
	RET
	
LCD_CMD:
	MOV P2,A
	CLR P3.0
	CLR P3.1
	SETB P3.2
	ACALL DELAY
	CLR P3.2
	ACALL DELAY
	RET
	
LCD_DATA:
	MOV P2,A
	SETB P3.0
	CLR P3.1
	SETB P3.2
	ACALL DELAY
	CLR P3.2
	ACALL DELAY
	RET
	
DISPLAY:
	CLR A
	MOVC A,@A+DPTR
	JZ SCROLL
	ACALL LCD_DATA
	INC DPTR
	SJMP DISPLAY
	
SCROLL:
	ACALL DELAY
	ACALL LCD_CMD
	MOV A, #1CH
	ACALL LCD_CMD
	SJMP SCROLL
	
DELAY:
	MOV R5,#255
	D1: MOV R6, #255
	D2: DJNZ R6, D2
	DJNZ R5, D1
	RET
	
MSG: DB 0x53, 0x49, 0x4C, 0x49, 0x43, 0x4F, 0x4E, 0  
	
END